/*
 * File : 24cxx.c
 * 
 * This file is part of eeprom device for 24cxx,such as at24c02/at24c16.
 * COPYRIGHT (C) 2016
 *
 * Change Logs:
 * Date           Author       Version      Notes
 * 2018-09-01     Acuity        1.00    first version.
 * 2020-04-20     Acuity        1.01    i2c总线提取出去.
 * 2023-01-12     zjcszn        2.00    
 * Note:
 * 
 */
 
#include "24cxx.h"  

#if _24CXX_USE_LOG
#include <stdio.h>
#define _24CXX_LOG(...)         printf(__VA_ARGS__)
#else
#define _24CXX_LOG(...)         ((void)0U)
#endif


#if _24CXX_USE_ASSERT
#include <assert.h>
#define _24CXX_ASSERT(exp)      assert(exp)
#else
#define _24CXX_ASSERT(exp)      ((void)0U)
#endif


/* Private function declaration ----------------------------------------------*/


static uint16_t get_eeprom_pagesize(_24cxx_model_t model);
static uint32_t get_eeprom_chipsize(_24cxx_model_t model);
static int16_t  _24cxx_param_check(_24cxx_dev_t *pdev, uint32_t addr, uint8_t *pbuf, uint32_t size);
static int16_t  _24cxx_write_handler(_24cxx_dev_t *pdev, uint32_t addr, uint8_t *pbuf, uint32_t size);




/* Exported function definition ----------------------------------------------*/

/**
 * @brief  write data to eeprom.
 * @param  pdev pointer to the eeprom device struct.
 * @param  addr the address of write to.
 * @param  pbuf the data to write.
 * @param  size number of bytes to write..
 * @retval return 0 if 0k,anything else is considered an error.
 */
int16_t _24cxx_write(_24cxx_dev_t *pdev, uint32_t addr, uint8_t *pbuf, uint32_t size)
{
  if (_24cxx_param_check(pdev, addr, pbuf, size) != _24CXX_OK)
  {
    return _24CXX_ERR_PARAM_INVALID;
  }
  
  if (pdev->type == _24CXX_FRAM)
  {/* FRAM */
    if (_24cxx_write_handler(pdev, addr, pbuf, size) != _24CXX_OK) 
    {
      return _24CXX_ERR_WRITE_FAILED;
    }
  }
  else
  {/* EEPROM */
    uint16_t write_len;
    uint16_t page_size;
    uint16_t page_remain;

    page_size = get_eeprom_pagesize(pdev->model);
    while (size > 0)
    {
      page_remain = page_size - (addr % page_size);
      write_len   = size > page_remain ? page_remain : size;
      if (_24cxx_write_handler(pdev, addr, pbuf, write_len) != _24CXX_OK)
      {
        return _24CXX_ERR_WRITE_FAILED;
      }
      size -= write_len;
      pbuf += write_len;
      addr += write_len;
      if (pdev->page_write_delay) 
      {
        pdev->page_write_delay();    /*eeprom need wait*/
      }
    }
  }
  return _24CXX_OK;
}

/**
 * @brief  read from the eeprom.
 * @param  pdev pointer to the eeprom device struct.
 * @param  addr the address to read from.
 * @param  pbuf where to put read data.
 * @param  size number of bytes to read.
 * @retval return 0 if 0k,anything else is considered an error.
 */
int16_t _24cxx_read(_24cxx_dev_t *pdev,uint32_t addr, uint8_t *pbuf, uint32_t size)
{  
  if (_24cxx_param_check(pdev, addr, pbuf, size) != _24CXX_OK)
  {
    return _24CXX_ERR_PARAM_INVALID;
  }

  uint8_t  dev_addr = 0;
  uint32_t mem_addr = 0;
  uint32_t mem_addr_len = 0;
  
  if (pdev->model > _24C16)
  {/*24c32-24c2048*/
    dev_addr = pdev->dev_addr | ((addr >> 16) & 0x7);
    mem_addr = addr & 0xFFFF;
    mem_addr_len = 2;
  }
  else
  {/*24c01-24c16*/
    dev_addr = pdev->dev_addr | ((addr >>  8) & 0x7);
    mem_addr = addr & 0xFF;
    mem_addr_len = 1;
  }
  
  if (pdev->i2c_mem_read(dev_addr, mem_addr, mem_addr_len, pbuf, size) != _24CXX_OK)
  {
    _24CXX_LOG("24CXX Error: Read Failed\r\n");
    return _24CXX_ERR_READ_FAILED;
  }
  
  return _24CXX_OK;
}

/**
 * @brief  erase the eeprom.
 * @param  pdev pointer to the eeprom device struct.
 * @param  addr the address to erase from.
 * @param  data padding data.
 * @param  size number of bytes to erase.
 * @retval return 0 if ok,anything else is considered an error.
 */
int16_t _24cxx_erase(_24cxx_dev_t *pdev,uint32_t addr, uint8_t data, uint32_t size)
{

  if (_24cxx_param_check(pdev, addr, &data, size) != _24CXX_OK)
  {
    return _24CXX_ERR_PARAM_INVALID;
  }

  for (int i = 0; i < size; i++, addr++)
  {
    if (_24cxx_write_handler(pdev, addr, &data, 1) != _24CXX_OK)
    {
      _24CXX_LOG("24CXX Error: Erase Failed\r\n");
      return _24CXX_ERR_ERASE_FAILED;
    }
    if (pdev->type == _24CXX_EEPROM && pdev->page_write_delay)
    {
      pdev->page_write_delay();
    }
  }
        
  return _24CXX_OK;
}

/**
 * @brief compare eeprom data and buffer data
 * 
 * @param pdev pointer to the eeprom device struct.
 * @param addr the address of write to.
 * @param pbuf the data to write.
 * @param size number of bytes to write..
 * @return int16_t return 0 if ok,anything else is considered an error.
 */
int16_t _24cxx_compare(_24cxx_dev_t *pdev, uint32_t addr, uint8_t *pbuf, uint32_t size)
{
  if (_24cxx_param_check(pdev, addr, pbuf, size) != _24CXX_OK)
  {
    return _24CXX_ERR_PARAM_INVALID;
  }

  uint8_t tmp;
  /* check write success */
  for (int i = 0; i < size; i++, addr++, pbuf++) 
  {
    if (_24cxx_read(pdev, addr, &tmp, 1) != _24CXX_OK)
    {
      return _24CXX_ERR_READ_FAILED;
    }
    if (*pbuf != tmp)
    {
      _24CXX_LOG("24CXX Error: Compare Failed\r\n");
      return _24CXX_ERR_COMPARE_FAILED;
    } 
  }
  return _24CXX_OK;
}

/* Private function definition -----------------------------------------------*/

/**
 * @brief  get page size
 * @param  model:eeprom model
 * @retval page size
 */  
static uint16_t get_eeprom_pagesize(_24cxx_model_t model) 
{
  switch(model)
  {
    case _24C01:
    case _24C02:
      return 8;
      
    case _24C04:
    case _24C08:
    case _24C16:
      return 16;
      
    case _24C32:
    case _24C64:
      return 32;
        
    case _24C128:
    case _24C256:
      return 64;

    case _24C512:
      return 128;

    case _24C1024:
      return 256;
      
    default:
      return 0;
  }
}

/**
 * @brief  get chip size
 * @param  model:eeprom model
 * @retval chip size,uinit:byte 
 */  
static uint32_t get_eeprom_chipsize(_24cxx_model_t model) 
{
  switch(model)
  {
    case _24C01:
      return 128U;
    case _24C02:
      return 256U;
    case _24C04:
      return 512U;
    case _24C08:
      return 1024U;
    case _24C16:
      return 2048U;
    case _24C32:
      return 4096U;
    case _24C64:
      return 8192U;
    case _24C128:
      return 16384U;
    case _24C256:
      return 32768U;
    case _24C512:
      return 65536U;
    case _24C1024:
      return 131072U;
    default:
      return 0U;
  }
}

/**
 * @brief  write operating function. 
 * @param  pdev pointer to the eeprom device struct.
 * @param  addr the address of write to.
 * @param  pbuf the data to write.
 * @param  size number of bytes to write..
 * @retval return 0 if 0k,anything else is considered an error.
 */
static int16_t _24cxx_write_handler(_24cxx_dev_t *pdev, uint32_t addr, uint8_t *pbuf, uint32_t size)
{
  uint8_t  dev_addr = 0;
  uint32_t mem_addr = 0;
  uint32_t mem_addr_len = 0;

  #if _24CXX_CHECK_PAGE_OVERFLOW
  uint16_t page_size = get_eeprom_pagesize(pdev->model);
  if (pdev->type == _24CXX_EEPROM)
  {
    if (((addr % page_size) + size) > page_size)
    {
      _24CXX_LOG("24CXX Error: Addr:0x%X, Size:%u --> Page Overflow\r\n", addr, size);
      return _24CXX_ERR_PAGE_OVERFLOW;
    }
  }
  #endif
  
  if (pdev->model > _24C16)
  {/*24c32-24c2048*/
    dev_addr = pdev->dev_addr | ((addr >> 16) & 0x7);
    mem_addr = addr & 0xFFFF;
    mem_addr_len = 2;
  }
  else
  {/*24c01-24c16*/
    dev_addr = pdev->dev_addr | ((addr >>  8) & 0x7);
    mem_addr = addr & 0xFF;
    mem_addr_len = 1;
  }
  
  if (pdev->wp)   /*release write protect*/
  {
    pdev->wp(0);
  }
  
  if (pdev->i2c_mem_write(dev_addr, mem_addr, mem_addr_len, pbuf, size) != _24CXX_OK)
  {
    _24CXX_LOG("24CXX Error: Write Failed\r\n");
    return _24CXX_ERR_WRITE_FAILED;
  }
  
  if (pdev->wp)
  {
    pdev->wp(1);  /*write protect*/
  }
  
  return _24CXX_OK;
}

/**
 * @brief check param function
 * 
 * @param  pdev pointer to the eeprom device struct.
 * @param  addr the address of write to.
 * @param  pbuf the data to write.
 * @param  size number of bytes to write or read..
 * @return int16_t return 0 if 0k,anything else is considered an error.
 */
static int16_t _24cxx_param_check(_24cxx_dev_t *pdev, uint32_t addr, uint8_t *pbuf, uint32_t size) {

  /* check validty of param */
  #if _24CXX_CHECK_PARAM
  if (!pdev) 
  {
    _24CXX_LOG("24CXX Param Error: Device Handle NULL\r\n");
    return _24CXX_ERR_PARAM_DEVICE;
  }
  if (!pdev->i2c_mem_write || !pdev->i2c_mem_read) 
  {
    _24CXX_LOG("24CXX Param Error: Write or Read Function Not Definition\r\n");
    return _24CXX_ERR_PARAM_DEVICE;
  }
  if (pdev->type == _24CXX_EEPROM && !pdev->page_write_delay)
  {
    _24CXX_LOG("24CXX Param Error: EEPROM Write Delay Function Not Definition\r\n");
    return _24CXX_ERR_PARAM_DEVICE;
  }
  if (addr >= get_eeprom_chipsize(pdev->model)) 
  {
    _24CXX_LOG("24CXX Param Error: Address Out of Bounds\r\n");
    return _24CXX_ERR_PARAM_MEMADDR;
  }
  if (size >  get_eeprom_chipsize(pdev->model)) 
  {
    _24CXX_LOG("24CXX Param Error: Length Out of Bounds\r\n");
    return _24CXX_ERR_PARAM_LENGTH;
  }
  if (!pbuf) 
  {
    _24CXX_LOG("24CXX Param Error: Data Buffer NULL\r\n");
    return _24CXX_ERR_PARAM_BUFFER;
  }
  #endif

  /* check overflow on the write or read operation */
  #if _24CXX_CHECK_CHIP_OVERFLOW
  if ((addr + size) > get_eeprom_chipsize(pdev->model))  /*the over flow of chip size*/
  {
    _24CXX_LOG("24CXX Error: Addr:0x%X, Size:%u --> Chip Overflow\r\n", addr, size);
    return _24CXX_ERR_CHIP_OVERFLOW;
  }
  #endif

  return _24CXX_OK;
}

/* Test function declaration -------------------------------------------------*/


#if _24CXX_USE_TEST

#include "bsp_i2c_sw.h"

/* private variables */
static soft_i2c_dev_t dev_test_i2c = {0};
static _24cxx_dev_t   dev_test_eep = {0};

/* test dummy data */
static uint8_t dummy_data []= 
{
0xC9, 0x22, 0x16, 0x66, 0xE6, 0xE8, 0x8C, 0x97, 0xF4, 0x30, 0xC5, 0x39, 0xF9, 0x63, 0x23, 0x71, 
0x48, 0x7E, 0x83, 0x0A, 0xE7, 0x54, 0xB6, 0xBC, 0xEC, 0x0F, 0xCA, 0x46, 0x13, 0x35, 0x61, 0x2B, 
0x98, 0xCE, 0x5B, 0x0A, 0xBB, 0x29, 0x2C, 0xEE, 0x5A, 0xF3, 0xFB, 0xBB, 0x0F, 0x71, 0x55, 0xD6, 
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0x9E, 0x9F, 0x48, 0xD2, 0xB9, 0xA6, 0x97, 0xED, 0x06, 0x64, 0x29, 0x07, 0xCD, 0x0D, 0x08, 0x17, 
};

/* eeprom i2c write function */
static int dev_test_i2c_write(uint8_t dev_addr, uint16_t mem_addr, uint16_t addr_size, const void *send_buff, uint32_t send_size)
{
  dev_test_i2c.dev_addr = dev_addr;
  if (soft_i2c_master_mem_write(&dev_test_i2c, mem_addr, addr_size, send_buff, send_size) != SOFT_I2C_OK)
  {
    return _24CXX_ERR_TRANS_FAILED;
  }
  else
  {
    return _24CXX_OK;
  }
}

/* eeprom i2c read function */
static int dev_test_i2c_read(uint8_t dev_addr, uint16_t mem_addr, uint16_t addr_size, void *recv_buff, uint32_t recv_size)
{
  dev_test_i2c.dev_addr = dev_addr;
  if (soft_i2c_master_mem_read(&dev_test_i2c, mem_addr, addr_size, recv_buff, recv_size) != SOFT_I2C_OK)
  {
    return _24CXX_ERR_TRANS_FAILED;
  }
  else
  {
    return _24CXX_OK;
  }
}

/* eeprom i2c write delay function */
static void dev_test_wr_delay(void) 
{
  HAL_Delay(_24CXX_WRITE_DELAY);
}

/* eeprom i2c write protection function */
static void dev_test_wp(uint8_t ctrl)
{
  // TO DO
}

/* eeprom driver test function */
int16_t _24cxx_test(void)
{
  /* i2c and eeprom device init */
  dev_test_i2c.scl.port = _24CXX_DEMO_SCL_PORT;
  dev_test_i2c.scl.pin  = _24CXX_DEMO_SCL_PIN;
  dev_test_i2c.sda.port = _24CXX_DEMO_SDA_PORT;
  dev_test_i2c.sda.pin  = _24CXX_DEMO_SDA_PIN;
  dev_test_i2c.dev_addr = _24CXX_DEMO_ADDR;
  
  soft_i2c_init(&dev_test_i2c, 400);

  dev_test_eep.type     = _24CXX_DEMO_TYPE;
  dev_test_eep.model    = _24CXX_DEMO_MODEL;
  dev_test_eep.dev_addr = _24CXX_DEMO_ADDR;
  
  dev_test_eep.wp               = dev_test_wp;
  dev_test_eep.i2c_mem_read     = dev_test_i2c_read;
  dev_test_eep.i2c_mem_write    = dev_test_i2c_write;
  dev_test_eep.page_write_delay = dev_test_wr_delay;
  
  printf("24CXX EEPROM Driver Test Start--------------\r\n\r\n");

  /* write eeprom test */

  if (_24cxx_write(&dev_test_eep, 0, dummy_data, 1024) != _24CXX_OK)
  {
    printf("EEPROM Write Failed\r\n");
    return _24CXX_ERR_WRITE_FAILED;
  }
  else 
  {
    printf("EEPROM Write Success\r\n");
  }

  if (_24cxx_compare(&dev_test_eep, 0, dummy_data, 1024) != _24CXX_OK)
  {
    printf("EEPROM Write Compare Failed\r\n");
    return _24CXX_ERR_COMPARE_FAILED;
  }
  else
  {
    printf("EEPROM Write Compare Success\r\n");
  }

  /* erase eeprom test */

  if (_24cxx_erase(&dev_test_eep, 0, 0XFF, 1024) != _24CXX_OK)
  {
    printf("EEPROM Erase Failed\r\n");
    return _24CXX_ERR_WRITE_FAILED;
  }
  else 
  {
    printf("EEPROM Erase Success\r\n");
  }

  uint8_t recv_tmp;
  for (int i = 0; i < 1024; i++) 
  {
    if (_24cxx_read(&dev_test_eep, i, &recv_tmp, 1) != _24CXX_OK)
    {
      printf("EEPROM Read Failed\r\n");
      return _24CXX_ERR_READ_FAILED;
    }
    if (recv_tmp != 0XFF)
    {
      printf("EEPROM Erase Compare Failed\r\n");
      return _24CXX_ERR_COMPARE_FAILED;
    }
  }
  printf("EEPROM Erase Compare Success\r\n\r\n");

  printf("24CXX EEPROM Driver Test End ----------------\r\n");

  return _24CXX_OK;
}



#endif

